## conf/layer.conf
```bitbake
# We have a conf and classes directory, add to BBPATH
BBPATH .= ":${LAYERDIR}"

# We have a packages directory, add to BBFILES
BBFILES += "${LAYERDIR}/recipes-*/*/*.bb \
            ${LAYERDIR}/recipes-*/*/*.bbappend"

BBFILE_COLLECTIONS += "custom-layer"
BBFILE_PATTERN_custom-layer := "^${LAYERDIR}/"
BBFILE_PRIORITY_custom-layer = "25"

LAYERSERIES_COMPAT_custom-layer = "kirkstone langdale mickledore scarthgap"

#LAYERDEPENDS_lencore-layer = " \
#    fsl-bsp-release \
#"

#BBFILES_DYNAMIC += " \
#    meta-ml:${LAYERDIR}/dynamic-layers/meta-ml/*/*/*.bb \
#    meta-ml:${LAYERDIR}/dynamic-layers/meta-ml/*/*/*.bbappend \
#"
```
